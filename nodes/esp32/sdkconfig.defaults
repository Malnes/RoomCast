## nodes/esp32/sdkconfig.defaults
```kconfig
# RoomCast ESP32-S3 baseline for N16R8 modules (16MB flash + 8MB PSRAM)
CONFIG_IDF_TARGET="esp32s3"
CONFIG_ESPTOOLPY_FLASHSIZE_16MB=y
CONFIG_ESPTOOLPY_FLASHSIZE="16MB"
CONFIG_SPIRAM=y
CONFIG_ESP32S3_SPIRAM_SUPPORT=y
```
